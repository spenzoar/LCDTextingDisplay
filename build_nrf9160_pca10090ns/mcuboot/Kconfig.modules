## build_nrf9160_pca10090ns/mcuboot/Kconfig.modules
```kconfig
osource "C:/GitHub/NRF91/ncs/nrf/Kconfig.nrf"

osource "C:/GitHub/NRF91/ncs/bootloader/mcuboot/zephyr/Kconfig"

osource "C:/GitHub/NRF91/ncs/nrfxlib/Kconfig.nrfxlib"
```
